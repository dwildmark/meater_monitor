## CMakeLists.txt
```
# SPDX-License-Identifier: Apache-2.0

set(CMAKE_EXPORT_COMPILE_COMMANDS ON)

cmake_minimum_required(VERSION 3.13.1)
find_package(Zephyr REQUIRED HINTS $ENV{ZEPHYR_BASE})
project(central)

target_sources(app PRIVATE
  src/main.c
  src/temperature_display.c
  src/probe_connection.c
)

zephyr_library_include_directories(include)
```

## west.yml
```
manifest:
  remotes:
    - name: zephyrproject-rtos
      url-base: https://github.com/zephyrproject-rtos
  projects:
    - name: zephyr
      remote: zephyrproject-rtos
      revision: master
      import: true
  self:
    path: meater_monitor
```

## prj.conf
```kconfig
# Bluetooth settings
CONFIG_BT=y
CONFIG_BT_CENTRAL=y
CONFIG_BT_GATT_CLIENT=y
CONFIG_BT_GATT_AUTO_DISCOVER_CCC=y

# Display settings
CONFIG_SPI=y
CONFIG_SSD16XX=y
CONFIG_HEAP_MEM_POOL_SIZE=16384
CONFIG_DISPLAY=y
CONFIG_CHARACTER_FRAMEBUFFER=y

# Release build settings
CONFIG_SERIAL=n

# Development settings
# CONFIG_LOG=y
# CONFIG_ASSERT=y
```

## src/main.c
```c
#include <sys/util.h>
#include <logging/log.h>

#include <probe_connection.h>
#include <temperature_display.h>

LOG_MODULE_REGISTER(main, 4);

static int old_inner = INT32_MAX;
static int old_ambient = INT32_MAX;

void temperature_data_callback(const struct temperature_data_raw *data) {
	bool update_display = false;

	uint16_t inner = data->data[0] | data->data[1] << 8;
	int inner_celsius = (int)(((float)inner + 8.0) / 16.0);

	if (inner_celsius != old_inner) {
		temperature_display_set_inner_temperature(inner_celsius, 'C');
		old_inner = inner_celsius;
		update_display = true;
	}

	uint16_t r_ambient = data->data[2] | data->data[3] << 8;
	uint16_t o_ambient = data->data[4] | data->data[5] << 8;

	int ambient = (int)(inner + (MAX(0, ((((r_ambient - MIN(48, o_ambient)) * 16) * 589)) / 1487)));

	int ambient_celsius = (int)(((float)ambient + 8.0) / 16.0);

	if (ambient_celsius != old_ambient) {
		temperature_display_set_ambient_temperature(ambient_celsius, 'C');
		old_ambient = ambient_celsius;
		update_display = true;
	}

	if (update_display) {
		temperature_display_update();
	}

	LOG_DBG("Inner: %d, Outer: %d", inner_celsius, ambient_celsius);
}

void main(void)
{
	temperature_display_init();

	probe_connection_init(temperature_data_callback);
}
```

## include/probe_connection.h
```c
/**
 * Copyright 2020 Dennis Wildmark
 */

#ifndef PROBE_CONNECTION_H 
#define PROBE_CONNECTION_H

#include <stdint.h>

struct temperature_data_raw {
    uint8_t data[8];
};

typedef void (*temperature_data_callback_t)(const struct temperature_data_raw *data);

int probe_connection_init(temperature_data_callback_t temperature_cb);

#endif /* PROBE_CONNECTION_H */
```

## include/temperature_display.h
```c
/**
 * Copyright 2020 Dennis Wildmark
 */

#ifndef TEMPERATURE_DISPLAY_H
#define TEMPERATURE_DISPLAY_H

int temperature_display_init(void);

int temperature_display_update(void);

int temperature_display_set_inner_temperature(int inner_temperature, char unit);

int temperature_display_set_ambient_temperature(int ambient_temperature, char unit);

#endif /* TEMPERATURE_DISPLAY_H */
```

## src/probe_connection.c
```c
/* main.c - Application main entry point */

/*
 * Copyright (c) 2015-2016 Intel Corporation
 *
 * SPDX-License-Identifier: Apache-2.0
 */

#include <zephyr/types.h>
#include <stddef.h>
#include <errno.h>
#include <zephyr.h>

#include <bluetooth/bluetooth.h>
#include <bluetooth/hci.h>
#include <bluetooth/conn.h>
#include <bluetooth/uuid.h>
#include <bluetooth/gatt.h>
#include <sys/byteorder.h>
#include <sys/util.h>
#include <logging/log.h>

#include <temperature_display.h>
#include <probe_connection.h>

LOG_MODULE_REGISTER(probe_conn, 4);

static void start_scan(void);

static struct bt_conn *default_conn;

static temperature_data_callback_t temperature_callback = NULL;

static bool decode_ad_data(struct bt_data *data, void *user_data) {
	const bt_addr_le_t *addr = user_data;
	if (data->type == 0x03 && data->data_len == 2 && 
			data->data[0] == 0x0a && data->data[1] == 0x18) { // Complete list of 16 bit service uuid type

		LOG_DBG("Found MEATER+. Stopping LE scan");
		if (bt_le_scan_stop()) {
			LOG_DBG("Failed to stop LE scan.");
			return false;
		}

		LOG_DBG("Attempting to connect...");

		int err = bt_conn_le_create(addr, BT_CONN_LE_CREATE_CONN,
			BT_LE_CONN_PARAM_DEFAULT, &default_conn);
		if (err) {
			LOG_DBG("Create conn failed (%u)\n", err);
			start_scan();
		}
		return false;
	}

	return true;
}

static void device_found(const bt_addr_le_t *addr, int8_t rssi, uint8_t type,
			 struct net_buf_simple *ad)
{
	char addr_str[BT_ADDR_LE_STR_LEN];
	// int err;

	if (default_conn) {
		return;
	}

	/* We're only interested in connectable events */
	if (type != BT_GAP_ADV_TYPE_ADV_IND &&
	    type != BT_GAP_ADV_TYPE_ADV_DIRECT_IND) {
		return;
	}

	bt_addr_le_to_str(addr, addr_str, sizeof(addr_str));

	bt_data_parse(ad, decode_ad_data, (void *)addr);
}

static void start_scan(void)
{
	int err;

	/* This demo doesn't require active scan */
	err = bt_le_scan_start(BT_LE_SCAN_PASSIVE, device_found);
	if (err) {
		LOG_DBG("Scanning failed to start (err %d)\n", err);
		return;
	}

	LOG_DBG("Scanning successfully started\n");
}

uint8_t temperature_notify_callback(struct bt_conn *conn, struct bt_gatt_subscribe_params *params, const void *data, uint16_t length) {
	if (!data) {
		LOG_DBG("Unsubscribed");
		return BT_GATT_ITER_STOP;
	}

	if (temperature_callback != NULL) {
		temperature_callback(data);
	}

	return BT_GATT_ITER_CONTINUE;
}

static struct bt_gatt_discover_params discover_ccc = {0};
static struct bt_gatt_subscribe_params subscribe_params = {0};

static uint8_t discover_temperature_attribute_cb(struct bt_conn *conn, const struct bt_gatt_attr *attr, struct bt_gatt_discover_params *params) {
	if (attr == NULL) {
		LOG_DBG("Discovery ended");
	} else {
		LOG_DBG("Discover temperature attribute: handle 0x%4X, perm 0x%4X", attr->handle, attr->perm);
		subscribe_params.notify = temperature_notify_callback,
		subscribe_params.value_handle = attr->handle + 1,
		subscribe_params.ccc_handle = 0,
		subscribe_params.end_handle = 0xffff,
		subscribe_params.disc_params = &discover_ccc,
		subscribe_params.value = BT_GATT_CCC_NOTIFY,

		bt_gatt_subscribe(conn, &subscribe_params);
	}

	return BT_GATT_ITER_STOP;
}

static struct bt_uuid_128 temperature_uuid = BT_UUID_INIT_128(
		BT_UUID_128_ENCODE(0x7edda774, 0x045e, 0x4bbf, 0x909b, 0x45d1991a2876));

// static struct bt_uuid_128 primary_service = BT_UUID_INIT_128(
// 		BT_UUID_128_ENCODE(0xa75cc7fc, 0xc956, 0x488f, 0xac2a, 0x2dbc08b63a04));

static struct bt_gatt_discover_params discover_temperature = {
		.uuid = &temperature_uuid.uuid,
		.func = discover_temperature_attribute_cb,
		.type = BT_GATT_DISCOVER_CHARACTERISTIC,
		.start_handle = 0x0001,
		.end_handle = 0xffff,
};


// static uint8_t discover_battery_attribute(struct bt_conn *conn, const struct bt_gatt_attr *attr, struct bt_gatt_discover_params *params) {
// 	LOG_DBG("Discover battery attribute");
// }

static void connected(struct bt_conn *conn, uint8_t err)
{
	// char addr[BT_ADDR_LE_STR_LEN];

	// bt_addr_le_to_str(bt_conn_get_dst(conn), addr, sizeof(addr));

	if (err) {
		LOG_DBG("Failed to connect (%u)\n", err);

		bt_conn_unref(default_conn);
		default_conn = NULL;

		start_scan();
		return;
	}

	if (conn != default_conn) {
		return;
	}

	LOG_DBG("Connected");

	err = bt_gatt_discover(conn, &discover_temperature);

	if (err) {
		LOG_ERR("Discover failed (err 0x%4X", err);
	}

	LOG_DBG("Discovering characteristics");
}

static void disconnected(struct bt_conn *conn, uint8_t reason)
{
	char addr[BT_ADDR_LE_STR_LEN];

	if (conn != default_conn) {
		return;
	}

	bt_addr_le_to_str(bt_conn_get_dst(conn), addr, sizeof(addr));

	LOG_DBG("Disconnected (reason 0x%02x)\n", reason);

	bt_conn_unref(default_conn);
	default_conn = NULL;

	start_scan();
}

static struct bt_conn_cb conn_callbacks = {
		.connected = connected,
		.disconnected = disconnected,
};

int probe_connection_init(temperature_data_callback_t temperature_cb) {
	int err;

	err = bt_enable(NULL);
	if (err) {
		LOG_DBG("Bluetooth init failed (err %d)\n", err);
		return -1;
	}

	LOG_DBG("Bluetooth initialized\n");

	temperature_callback = temperature_cb;

	bt_conn_cb_register(&conn_callbacks);

	start_scan();

	return 0;
}
```

## src/temperature_display.c
```c
#include <logging/log.h>
#include <errno.h>
#include <display/cfb.h>
#include <stdio.h>

#include <temperature_display.h>

LOG_MODULE_REGISTER(temp_display, 4);

static struct device *dev = NULL;

static char inner_temp_buffer[12] = {0};
static char ambient_temp_buffer[12] = {0};

static uint8_t ppt = 0;

int temperature_display_init(void) {
    LOG_DBG("Temperature display init");

    int err;

	dev = device_get_binding("SSD16XX");

	if (dev == NULL) {
		LOG_ERR("Device not found");
		return -ENODEV;
	}

	err = cfb_framebuffer_init(dev);
	if (err) {
		LOG_ERR("Framebuffer initialization failed!");
		return err;
	}

    err = cfb_framebuffer_set_font(dev, 2);
	if (err) {
		LOG_ERR("Framebuffer set font error=%d", err);
		return err;
	}

	LOG_DBG("Framebuffer initialized");

	ppt = cfb_get_display_parameter(dev, CFB_DISPLAY_PPT);

	err = cfb_framebuffer_clear(dev, true);
	if (err) {
		LOG_ERR("Framebuffer clear error=%d", err);
		return err;
	}

	err = cfb_framebuffer_finalize(dev);
	if (err) {
		LOG_ERR("Framebuffer finalize error=%d", err);
		return err;
	}

	return err;
}

int temperature_display_update(void) {
    cfb_framebuffer_clear(dev, false);

    cfb_print(dev, inner_temp_buffer, 0, 0);
    cfb_print(dev, ambient_temp_buffer, 0, 4 * ppt);

    cfb_framebuffer_finalize(dev);

    return 0;
}

int temperature_display_set_inner_temperature(int inner_temperature, char unit) {
    LOG_DBG("Inner temperature: %d", inner_temperature);

    snprintf(inner_temp_buffer, sizeof(inner_temp_buffer), "Inner:%3d %c", inner_temperature, unit);

    return 0;
}

int temperature_display_set_ambient_temperature(int ambient_temperature, char unit) {
    LOG_DBG("Ambient temperature: %d", ambient_temperature);

    snprintf(ambient_temp_buffer, sizeof(ambient_temp_buffer), "Outer:%3d %c", ambient_temperature, unit);

    return 0;
}
```
